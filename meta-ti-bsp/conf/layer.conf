## meta-ti-bsp/conf/layer.conf
```bitbake
# We have a conf and classes directory, append to BBPATH
BBPATH .= ":${LAYERDIR}"
METATIBASE := '${@os.path.normpath("${LAYERDIR}/")}'

# We have a recipes directory, add to BBFILES
BBFILES += "${LAYERDIR}/recipes*/*/*.bb ${LAYERDIR}/recipes*/*/*.bbappend"

BBFILE_COLLECTIONS += "meta-ti-bsp"
BBFILE_PATTERN_meta-ti-bsp := "^${LAYERDIR}/"
BBFILE_PRIORITY_meta-ti-bsp = "6"

BBMASK += "${LAYERDIR}/recipes-core/udev/"
BBMASK += "${LAYERDIR}/recipes-kernel/linux/"
BBMASK += "${LAYERDIR}/recipes-devtools/k3conf/"

LAYERSERIES_COMPAT_meta-ti-bsp = "kirkstone langdale mickledore"

LICENSE_PATH += "${LAYERDIR}/licenses"

LAYERDEPENDS_meta-ti-bsp = " \
    core \
    meta-arm \
"

SIGGEN_EXCLUDERECIPES_ABISAFE += " \
    ti-sgx-ddk-km \
    ti-sgx-ddk-um \
"

HOSTTOOLS_NONFATAL += "truncate xxd comm"

RECIPE_LIST_REASON:meta-ti-bsp = "You are about to enable third-party components, there is additional third-part \
licensing involved, and you might need to consult with your legal department."
```
